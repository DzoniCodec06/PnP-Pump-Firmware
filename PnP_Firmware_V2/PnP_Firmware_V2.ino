#include <Adafruit_GFX.h>
#include <Adafruit_SSD1306.h>
#include <Wire.h>
#include <Adafruit_NeoPixel.h>

#define SCREEN_WIDTH 128
#define SCREEN_HEIGHT 64
#define RST_PIN   -1
#define PIN        2
#define NUMPIXELS  3

Adafruit_SSD1306 oled(SCREEN_WIDTH, SCREEN_HEIGHT, &Wire, RST_PIN);

Adafruit_NeoPixel pixels(NUMPIXELS, PIN, NEO_GRB + NEO_KHZ800);



// 'page-1', 128x64px
const unsigned char page_1 [] PROGMEM = {
  0x00, 0x00, 0x00, 0x00, 0x00, 0x00, 0x00, 0x00, 0x00, 0x00, 0x00, 0x00, 0x00, 0x00, 0x00, 0x00,
  0x00, 0x00, 0x00, 0x00, 0x00, 0x00, 0x00, 0x00, 0x00, 0x00, 0x00, 0x00, 0x00, 0x00, 0x00, 0x00,
  0x00, 0x00, 0x00, 0x00, 0x00, 0x00, 0x00, 0x00, 0x00, 0x00, 0x00, 0x00, 0x00, 0x00, 0x00, 0x00,
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  0x00, 0x00, 0x00, 0x00, 0x00, 0x00, 0x00, 0x00, 0x00, 0x00, 0x00, 0x00, 0x00, 0x00, 0x00, 0x00
};

const unsigned char page_2 [] PROGMEM = {
  0x00, 0x00, 0x00, 0x00, 0x00, 0x00, 0x00, 0x00, 0x00, 0x00, 0x00, 0x00, 0x00, 0x00, 0x00, 0x00,
  0x00, 0x00, 0x00, 0x00, 0x00, 0x00, 0x00, 0x00, 0x00, 0x00, 0x00, 0x00, 0x00, 0x00, 0x00, 0x00,
  0x00, 0x00, 0x00, 0x00, 0x00, 0x00, 0x00, 0x00, 0x00, 0x00, 0x00, 0x00, 0x00, 0x00, 0x00, 0x00,
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  0x00, 0x00, 0x00, 0x00, 0x00, 0x00, 0x00, 0x00, 0x00, 0x00, 0x00, 0x00, 0x00, 0x00, 0x00, 0x00
};

// BAR DIMENSIONS 119px X 16px
const unsigned char bar [] PROGMEM = {
  0x0f, 0xff, 0xff, 0xff, 0xff, 0xff, 0xff, 0xff, 0xff, 0xff, 0xff, 0xff, 0xff, 0xff, 0xc0, 0x10,
  0x00, 0x00, 0x00, 0x00, 0x00, 0x00, 0x00, 0x00, 0x00, 0x00, 0x00, 0x00, 0x00, 0x20, 0x20, 0x00,
  0x00, 0x00, 0x00, 0x00, 0x00, 0x00, 0x00, 0x00, 0x00, 0x00, 0x00, 0x00, 0x10, 0x40, 0x00, 0x00,
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  0x20, 0x0f, 0xff, 0xff, 0xff, 0xff, 0xff, 0xff, 0xff, 0xff, 0xff, 0xff, 0xff, 0xff, 0xff, 0xc0
};


// Array of all bitmaps for convenience. (Total bytes used to store images in PROGMEM = 1040)
// const int page_all_LEN = 3;
const unsigned char* page_all[4] = {
  page_1,
  page_1,
  page_1,
  page_2
};

int btn_1;
int btn_2;
int btn_3;

int counter = 1;
int powr = 1;
bool power = false;

bool blow = false;

bool suck = false;

bool main_menu = true;

int s = 1;
int b = 1;

const int pump = 6; //Vacuum pump, activates when HIGH is applied!
//const int pedal = 7; //Foot pedal, input pullup mode!

void powerMenu(int pwr) {
  oled.clearDisplay();
  oled.setTextColor(WHITE);
  oled.setTextSize(2);
  oled.setCursor(33, 0);
  oled.print("Power");
  oled.setTextSize(2);
  oled.setCursor(1, 30);
  oled.print("-");
  oled.setCursor(113, 30);
  oled.print("+");
  switch (pwr) {
    case 1:
      oled.drawRect(15, 30, 15, 15, WHITE);
      oled.drawRect(35, 30, 15, 15, WHITE);
      oled.drawRect(55, 30, 15, 15, WHITE);
      oled.drawRect(75, 30, 15, 15, WHITE);
      oled.drawRect(95, 30, 15, 15, WHITE);
      pixels.setPixelColor(0, pixels.Color(0, 0, 0));
      pixels.setPixelColor(1, pixels.Color(0, 0, 0));
      pixels.setPixelColor(2, pixels.Color(0, 0, 0));
      pixels.show();
      //analogWrite(pump, 0);
      break;
    case 2:
      oled.fillRect(15, 30, 15, 15, WHITE);
      oled.drawRect(35, 30, 15, 15, WHITE);
      oled.drawRect(55, 30, 15, 15, WHITE);
      oled.drawRect(75, 30, 15, 15, WHITE);
      oled.drawRect(95, 30, 15, 15, WHITE);
      pixels.setPixelColor(0, pixels.Color(0, 100, 0));
      pixels.setPixelColor(1, pixels.Color(0, 0, 0));
      pixels.setPixelColor(2, pixels.Color(0, 0, 0));
      pixels.show();
      /*if (digitalRead(pedal) == LOW) {
        analogWrite(pump, 80);
        return;
        }
        else {
        analogWrite(pump, 0);
        } */
      break;
    case 3:
      oled.fillRect(15, 30, 15, 15, WHITE);
      oled.fillRect(35, 30, 15, 15, WHITE);
      oled.drawRect(55, 30, 15, 15, WHITE);
      oled.drawRect(75, 30, 15, 15, WHITE);
      oled.drawRect(95, 30, 15, 15, WHITE);
      pixels.setPixelColor(0, pixels.Color(0, 100, 0));
      pixels.setPixelColor(1, pixels.Color(50, 50, 0));
      pixels.setPixelColor(2, pixels.Color(0, 0, 0));
      pixels.show();
      /*if (digitalRead(pedal) == LOW) {
        analogWrite(pump, 135);
        return;
        }
        else {
        analogWrite(pump, 0);
        } */
      break;
    case 4:
      oled.fillRect(15, 30, 15, 15, WHITE);
      oled.fillRect(35, 30, 15, 15, WHITE);
      oled.fillRect(55, 30, 15, 15, WHITE);
      oled.drawRect(75, 30, 15, 15, WHITE);
      oled.drawRect(95, 30, 15, 15, WHITE);
      pixels.setPixelColor(0, pixels.Color(0, 100, 0));
      pixels.setPixelColor(1, pixels.Color(150, 100, 0));
      pixels.setPixelColor(2, pixels.Color(0, 0, 0));
      pixels.show();
      /*if (digitalRead(pedal) == LOW) {
        analogWrite(pump, 175);
        return;
        }
        else {
        analogWrite(pump, 0);
        } */
      break;
    case 5:
      oled.fillRect(15, 30, 15, 15, WHITE);
      oled.fillRect(35, 30, 15, 15, WHITE);
      oled.fillRect(55, 30, 15, 15, WHITE);
      oled.fillRect(75, 30, 15, 15, WHITE);
      oled.drawRect(95, 30, 15, 15, WHITE);
      pixels.setPixelColor(0, pixels.Color(0, 100, 0));
      pixels.setPixelColor(1, pixels.Color(150, 100, 0));
      pixels.setPixelColor(2, pixels.Color(80, 20, 0));
      pixels.show();
      /*if (digitalRead(pedal) == LOW) {
        analogWrite(pump, 225);
        return;
        }
        else {
        analogWrite(pump, 0);
        }*/
      break;
    case 6:
      oled.fillRect(15, 30, 15, 15, WHITE);
      oled.fillRect(35, 30, 15, 15, WHITE);
      oled.fillRect(55, 30, 15, 15, WHITE);
      oled.fillRect(75, 30, 15, 15, WHITE);
      oled.fillRect(95, 30, 15, 15, WHITE);
      pixels.setPixelColor(0, pixels.Color(0, 100, 0));
      pixels.setPixelColor(1, pixels.Color(150, 100, 0));
      pixels.setPixelColor(2, pixels.Color(100, 0, 0));
      pixels.show();
      /*if (digitalRead(pedal) == LOW) {
        analogWrite(pump, 255);
        return;
        }
        else {
        analogWrite(pump, 0);
        }*/
      break;
  }
  oled.display();
}

void suckMenu(int ss) {
  oled.clearDisplay();
  oled.setTextColor(WHITE);
  oled.setTextSize(2);
  oled.setCursor(40, 0);
  oled.print("Suck");
  oled.setTextSize(2);
  oled.setCursor(20, 30);
  oled.print("Suck:");
  oled.display();

  if (ss == 0) {
    if (b != 0) {
      oled.setCursor(80, 30);
      oled.print("On");
    } else {
      ss = 1;
      warning(ss); // OFF
    }
  } else if (ss == 1) {
    oled.setCursor(80, 30);
    oled.print("Off");
  }

  oled.display();
}

void blowMenu(int bs) {
  oled.clearDisplay();
  oled.setTextColor(WHITE);
  oled.setTextSize(2);
  oled.setCursor(40, 0);
  oled.print("Blow");
  oled.setTextSize(2);
  oled.setCursor(20, 30);
  oled.print("Blow:");
  oled.display();

  if (bs == 0) {
    if (s != 0) {
      oled.setCursor(80, 30);
      oled.print("On");
    } else {
      bs = 1;
      warning(bs); // OFF
    }

  } else if (bs == 1) {
    oled.setCursor(80, 30);
    oled.print("Off");
  }

  oled.display();
}

void warning(int n) {
  oled.clearDisplay();
  oled.setTextColor(WHITE);
  oled.setTextSize(2);
  oled.setCursor(20, 0);
  oled.print("Warning!");
  if (blow == true) {
    oled.setTextSize(1);
    oled.setCursor(10, 30);
    oled.print("You can't set Blow  to ON, beacuse Suck is already set to ON!");
    oled.display();
    delay(3000);
    b = 1;
    blowMenu(b);
  } else if (suck == true) {
    oled.setTextSize(1);
    oled.setCursor(10, 30);
    oled.print("You can't set Suck  to ON, beacuse Blow is already set to ON!");
    oled.display();
    delay(3000);
    s = 1;
    suckMenu(s);
  }
}

void drawMenu() {
  oled.clearDisplay();
  oled.drawBitmap(4, (counter < 2 ? counter * 19 : 39), bar, 119, 16, WHITE);
  oled.drawBitmap(0, 0, page_all[counter], 128, 64, WHITE);
  oled.display();
}

void setup() {
  if (!oled.begin(SSD1306_SWITCHCAPVCC, 0x3C)) for (;;);

  pixels.begin();
  pixels.clear();

  pinMode(3, INPUT_PULLUP);
  pinMode(5, INPUT_PULLUP);
  pinMode(4, INPUT_PULLUP);
  //pinMode(pedal, INPUT_PULLUP);
  pinMode(pump, OUTPUT);

  oled.clearDisplay();
  oled.drawBitmap(0, 0, page_1, 128, 64, WHITE);
  oled.drawBitmap(4, (counter * 19), bar, 119, 16, WHITE);
  oled.display();
}


void loop() {
  btn_1 = digitalRead(5);
  btn_3 = digitalRead(4);
  btn_2 = digitalRead(3);

  if (btn_1 == LOW) {
    if (main_menu == true && counter < 3) {
      counter += 1;
      drawMenu();

    } else if (suck == true && s < 1) {
      s += 1;
      suckMenu(s);

    } else if (blow == true && b < 1) {
      b += 1;
      blowMenu(b);
    } else if (power && powr < 6) {
      powr += 1;
      powerMenu(powr);
    }
  }
  if (btn_2 == LOW) {
    if (main_menu == true && counter > 1) {
      counter -= 1;
      drawMenu();
    } else if (suck == true && s > 0) {
      s -= 1;
      suckMenu(s);
    } else if (blow == true && b > 0) {
      b -= 1;
      blowMenu(b);
    } else if (power && powr > 1) {
      powr -= 1;
      powerMenu(powr);
    }
  }
  if (btn_3 == LOW) {
    switch (counter) {
      case 1:
        suck = !suck;
        main_menu = !main_menu;
        suck ? suckMenu(s) : drawMenu();
        break;
      case 2:
        blow = !blow;
        main_menu = !main_menu;
        blow ? blowMenu(b) : drawMenu();
        break;
      case 3:
        power = !power;
        main_menu = !main_menu;
        power ? powerMenu(powr) : drawMenu();
        break;
    }
  }

  delay(65);
}
